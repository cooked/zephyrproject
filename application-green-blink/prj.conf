## CMakeLists.txt
```
# SPDX-License-Identifier: Apache-2.0

cmake_minimum_required(VERSION 3.20.0)

# required for apps
find_package(Zephyr REQUIRED HINTS $ENV{ZEPHYR_BASE})

project(application-test)

# Alternatively, use a glob to include all C source files
# FILE(GLOB app_sources src/*.c)
# target_sources(app PRIVATE ${app_sources})
target_sources(app PRIVATE
	src/main.c
)

zephyr_include_directories(.)

# only necessary when building a zephyr lib
#zephyr_library_include_directories(.)

# add_subdirectory(drivers)
# target_include_directories(${PROJECT_NAME} PRIVATE drivers/IMU/mlx90393/src)
# target_link_directories(${PROJECT_NAME} PRIVATE drivers/IMU/mlx90393/src)
# target_link_libraries(${PROJECT_NAME} mlx90393)
```

## prj.conf
```kconfig
# general
CONFIG_STDOUT_CONSOLE=y
CONFIG_PRINTK=y
CONFIG_I2C=y
CONFIG_GPIO=y
CONFIG_PWM=y

# sensors
CONFIG_SENSOR=y


# pwm
#CONFIG_PWM=y

#debug
#CONFIG_DEBUG=y
#CONFIG_LOG=y
#CONFIG_LOG_MODE_IMMEDIATE=y
#CONFIG_SENSOR_LOG_LEVEL_DBG=y
#CONFIG_PWM_LOG_LEVEL_DBG=y
#CONFIG_CBPRINTF_FP_SUPPORT=y
```

## boards/thingy91_nrf9160ns.overlay
```dts
//  / {


// 	pwmleds {
// 		compatible = "pwm-leds";
// 		pwm_led0: pwm_led_0 {
// 			pwms = <&pwm0 0 PWM_MSEC(20) PWM_POLARITY_NORMAL>;
// 		};
// 		pwm_led1: pwm_led_1 {
// 			pwms = <&pwm0 1 PWM_MSEC(20) PWM_POLARITY_NORMAL>;
// 		};
// 		pwm_led2: pwm_led_2 {
// 			pwms = <&pwm0 2 PWM_MSEC(20) PWM_POLARITY_NORMAL>;
// 		};
// };


&i2c2 {
	compatible = "nordic,nrf-twim";
	status = "okay";
	sda-pin = <11>;
	scl-pin = <12>;

	// TODO: Switch to I2C_BITRATE_FAST so we get 400 kHz instead of 100 kHz
	// communication? Look at documentation and power usage...
	clock-frequency = <I2C_BITRATE_FAST>;

	/*iim42652_0: iim42652@68 {
		compatible = "invensense,iim42652";
		status = "okay";
		label = "IIM42652";
		reg = <0x68>;

		// GPIO pin for the interrupt
		//interrupt1-gpios = <&gpio0 8 (GPIO_ACTIVE_HIGH)>;
		//interrupt2-gpios = <&gpio0 9 (GPIO_ACTIVE_HIGH)>;
	};*/
};
```

## src/main.c
```c
// // /*
//  * Copyright (c) 2016 Intel Corporation
//  *
//  * SPDX-License-Identifier: Apache-2.0
//  */


/*
 * Copyright (c) 2016 Intel Corporation
 *
 * SPDX-License-Identifier: Apache-2.0
 */

#include <zephyr.h>
#include <zephyr/types.h>

#include <device.h>
#include <devicetree.h>
#include <drivers/gpio.h>


/* 1000 msec = 1 sec */
#define SLEEP_TIME_MS   1000

 #define LEDG_NODE DT_ALIAS(led1)
// /* The devicetree node identifier for the "led0" alias. */
#define LED_G DT_GPIO_LABEL(LEDG_NODE, gpios)
#define PIN DT_GPIO_PIN(LEDG_NODE, gpios)
#define FLAGS DT_GPIO_FLAGS(LEDG_NODE, gpios)

void main(void)
{
	const struct device *dev = device_get_binding(LED_G);
	bool led_is_on = true;
	int ret;


 	ret = gpio_pin_configure(dev, PIN, GPIO_OUTPUT_ACTIVE | FLAGS);
 	if (ret < 0) {
 		return;
 	}

 	while (1) {
		gpio_pin_set(dev, PIN, (int) led_is_on);
		led_is_on = !led_is_on;
 		k_msleep(SLEEP_TIME_MS);
 	}
}
```
